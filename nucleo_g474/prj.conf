## CMakeLists.txt
```
cmake_minimum_required(VERSION 3.20.0)

find_package(Zephyr REQUIRED)

project(
  g474_svpwm
  DESCRIPTION "SVPWM 3-phase inverter drive (STM32H743ZI -> STM32G474RE port)"
  VERSION 1
  LANGUAGES C
)

target_sources(app PRIVATE src/main.c)
target_sources(app PRIVATE src/control.c)
target_sources(app PRIVATE src/spi_cmd.c)

target_include_directories(app PRIVATE include)
```

## prj.conf
```kconfig
CONFIG_MAIN_STACK_SIZE=8192

# Console over ST-LINK VCP (LPUART1 on PA2/PA3)
CONFIG_SERIAL=y
CONFIG_CONSOLE=y
CONFIG_UART_CONSOLE=y
CONFIG_PRINTK=y

# Enable LOG so spi_cmd.c LOG_INF messages are visible on the VCP.
CONFIG_LOG=y
CONFIG_LOG_DEFAULT_LEVEL=3
CONFIG_LOG_MODE_DEFERRED=y

# spi_cmd.c logs %f values (freq/mag); cbprintf float formatting is off by
# default unless the FPU is enabled, so enable it explicitly.
CONFIG_CBPRINTF_FP_SUPPORT=y

# GPIO + pinctrl needed to mux the TIM1 PWM output pins.
# CONFIG_PWM enables the st,stm32-pwm driver for the pwm1 node in
# app.overlay; WITHOUT it the pwm1 pinctrl-0 (PA8..PA12/PB15 -> TIM1 AF)
# is never applied and no PWM reaches the pins even though TIM1 runs.
CONFIG_GPIO=y
CONFIG_PWM=y

# SPI1 master command link from the H7S78-DK slave (frequency/magnitude control)
CONFIG_SPI=y
```

## app.overlay
```dts
/*
 * SVPWM on NUCLEO-G474RE -- 3-phase inverter drive via TIM1.
 *
 * Register-level port of the STM32H743ZI SVPWM (control.c) to the G474,
 * with the timer constants/values taken from the corrected G474RETEST
 * reference project (Core/Src/main.c):
 *   - TIM1 center-aligned mode 1, prescaler 0 (170 MHz), ARR = 3935
 *     -> 2*3935 / 170e6 = 46.3 us => 21.6 kHz switching
 *   - PWM mode 1, active-low polarity on all channels
 *   - deadtime DTG = 170  (~1.25 us) -- fixes the wrong deadtime carried
 *     over from the H743ZI port (which used a bogus DTG value)
 *
 * Pin mapping (matches G474RETEST stm32g4xx_hal_msp.c HAL_TIM_MspPostInit):
 *   TIM1_CH1  PA8  TIM1_CH1N PA11
 *   TIM1_CH2  PA9  TIM1_CH2N PA12
 *   TIM1_CH3  PA10 TIM1_CH3N PB15
 *
 * The TIM1 pins/counters are driven directly from control.c (CMSIS register
 * access, like the H743ZI project), so the pwm node below is only used to
 * request the pinctrl muxing of the six output pins.
 *
 * FDCAN1 is enabled by default on the Nucleo-G474RE board using PA11 (RX)
 * and PA12 (TX) -- the same physical pins as TIM1_CH1N/CH2N -- so it must
 * be disabled to free those pins for the complementary PWM outputs.
 */

&timers1 {
	status = "okay";
	st,prescaler = <0>;
	st,countermode = <0x20>;

	pwm1: pwm {
		status = "okay";

		pinctrl-0 = <
			&tim1_ch1_pa8
			&tim1_ch1n_pa11

			&tim1_ch2_pa9
			&tim1_ch2n_pa12

			&tim1_ch3_pa10
			&tim1_ch3n_pb15
		>;
		pinctrl-names = "default";
	};
};

/* Free PA11/PA12 (FDCAN1 RX/TX) for TIM1_CH1N / TIM1_CH2N */
&fdcan1 {
	status = "disabled";
};

/*
 * SPI command link (master side).
 *
 * The H7S78-DK slave drives the SVPWM reference (frequency + magnitude) over
 * an SPI frame, and notifies the master by raising a GPIO line when a new
 * command is ready:
 *
 *   SPI1 master  -> H7S78 SPI4 slave :  SCK=PA5, MISO=PA6, MOSI=PA7, CS=PB6
 *   notify slave -> master          :  slave PD12 -> master PC7
 *
 * PC7 is an input the master watches (rising edge = new command frame ready);
 * on a rising edge the master clocks an 8-byte full-duplex frame from the
 * slave and applies set_frequency()/set_magnitude().
 */
&spi1 {
	status = "okay";
	pinctrl-0 = <&spi1_sck_pa5 &spi1_miso_pa6 &spi1_mosi_pa7>;
	pinctrl-names = "default";
};
```

## src/main.c
```c
#include <zephyr/kernel.h>
#include <zephyr/sys/printk.h>
#include "control.h"
#include "spi_cmd.h"

/*
 * g474_svpwm -- 3-phase inverter drive via SVPWM on TIM1.
 *
 * Transplants the STM32H743ZI SVPWM (control.c) to the NUCLEO-G474RE board,
 * with timer constants/registers corrected to match the verified G474RETEST
 * project. See control.c for the exact register values.
 */
int main(void)
{
    init_tim1_pwm();
    init_tim1_irq();
    spi_cmd_start();

    return 0;
}
```

## src/control.c
```c
/*
 * control.c -- SVPWM 3-phase inverter drive for STM32G474RE (NUCLEO-G474RE)
 *
 * Transplant of the STM32H743ZI Zephyr SVPWM. The H743ZI version had several
 * problems that are fixed here:
 *
 *   1. DEAD TIME: the H743ZI port wrote a bogus DTG value into TIM1->BDTR.
 *      For the G474 the correct value is DTG = 170 (~1.25 us at 170 MHz),
 *      taken from the verified G474RETEST reference project.
 *
 *   2. PWM PERIOD / SCALING: ARR is set to the G474-correct value 3935 for a
 *      21.6 kHz center-aligned switching frequency (2*3935/170e6 = 46.3 us).
 *
 *   3. SVPWM MATH: the duty computation now matches the verified G474RETEST
 *      iSVPWMz0() implementation, which produces CCR values directly in the
 *      [0, 3935] range instead of the factor-mistaken time*REAL2DIS scaling in
 *      the H743ZI version.
 *
 * The H743ZI CMSIS / Zephyr-style register access is preserved: TIM1 is set
 * up by direct register writes (bypassing the Zephyr PWM driver, which does
 * not expose center-aligned mode, complementary outputs or dead time).
 *
 * Register values verified against G474RETEST/Core/Src/main.c (MX_TIM1_Init):
 *   - Prescaler 0            (170 MHz timer clock)
 *   - Center-aligned mode 1  (CMS = 01)
 *   - ARR = 3935
 *   - PWM mode 1, active-low polarity on CH1..3 and CH1N..3N
 *   - DeadTime (DTG) = 170
 */

#include <zephyr/irq.h>
#include <stm32g474xx.h>
#include <math.h>
#include <zephyr/sys/printk.h>

/* Timer / switching parameters (G474RETEST-verified) */
#define PWM_PERIOD 3935                 /* TIM1->ARR: 2*3935/170e6 = 46.3 us */
#define SW_FREQ    21600.0f             /* 21.6 kHz switching frequency      */
#define TS         4.6296296296296296e-5f  /* 1 / SW_FREQ (full period)      */

/* Center-aligned update event fires on overflow AND underflow (2x / period) */
#define T_ISR      (TS / 2.0f)          /* 23.15 us per TIM1 update ISR      */

#define PI    3.141592653589793f
#define SQRT3 1.7320508075688772f
#define SQRT3_DIV2 0.866025403784439f
#define DEG2RAD    0.01745329251994329577f
#define PI_DIV3    1.04719755119659774615f

static float vdc = 10.0f;   /* DC bus voltage (V), matches G474RETEST Vdc  */
static float v_mag = 4.0f;  /* reference voltage magnitude (V) -> max 5 V  */
static float fout = 60.0f;  /* electrical frequency (Hz)                    */

void init_tim1_pwm(void)
{
    /* Enable TIM1 clock (APB2) */
    RCC->APB2ENR |= RCC_APB2ENR_TIM1EN;

    /* Reset timer */
    TIM1->CR1 = 0;

    /* Center-aligned mode 1 (CMS = 01): counter counts up then down */
    TIM1->CR1 |= TIM_CR1_CMS_0;

    /* Prescaler 0 -> timer runs at full 170 MHz kernel clock */
    TIM1->PSC = 0;

    TIM1->ARR = PWM_PERIOD;

    /* PWM mode 1 (OCxM = 110) + preload enable for CH1, CH2 (CCMR1),
     * CH3 (CCMR2).  CH4 unused. */
    TIM1->CCMR1 |= (6 << TIM_CCMR1_OC1M_Pos);
    TIM1->CCMR1 |= TIM_CCMR1_OC1PE;
    TIM1->CCMR1 |= (6 << TIM_CCMR1_OC2M_Pos);
    TIM1->CCMR1 |= TIM_CCMR1_OC2PE;
    TIM1->CCMR2 |= (6 << TIM_CCMR2_OC3M_Pos);
    TIM1->CCMR2 |= TIM_CCMR2_OC3PE;

    /* Enable CH1..3 plus complementary CH1N..3N */
    TIM1->CCER |= TIM_CCER_CC1E  |
                  TIM_CCER_CC1NE |
                  TIM_CCER_CC2E  |
                  TIM_CCER_CC2NE |
                  TIM_CCER_CC3E  |
                  TIM_CCER_CC3NE;

    /* Active-low polarity on every output (matches G474RETEST OCPolarity and
     * OCNPolarity = LOW).  The gate driver inverts the logic level, so a
     * logical "1" (duty on) appears as low on the pin. */
    TIM1->CCER |= TIM_CCER_CC1P;
    TIM1->CCER |= TIM_CCER_CC1NP;
    TIM1->CCER |= TIM_CCER_CC2P;
    TIM1->CCER |= TIM_CCER_CC2NP;
    TIM1->CCER |= TIM_CCER_CC3P;
    TIM1->CCER |= TIM_CCER_CC3NP;

    /* Dead time DTG = 170 -> ~1.25 us at 170 MHz (correct on G474). The H743ZI
     * port carried over a bogus DTG value; 170 is the G474RETEST value. */
    TIM1->BDTR &= ~TIM_BDTR_DTG;
    TIM1->BDTR |= (170 << TIM_BDTR_DTG_Pos);

    /* Main output enable */
    TIM1->BDTR |= TIM_BDTR_MOE;

    /* Auto-reload preload (buffered ARR) */
    TIM1->CR1 |= TIM_CR1_ARPE;

    /* Initial 50% duty on all three phases */
    TIM1->CCR1 = PWM_PERIOD / 2;
    TIM1->CCR2 = PWM_PERIOD / 2;
    TIM1->CCR3 = PWM_PERIOD / 2;

    /* Generate update event to load preload registers */
    TIM1->EGR |= TIM_EGR_UG;

    /* Enable update interrupt (drives the SVPWM reference update) */
    TIM1->DIER |= TIM_DIER_UIE;

    /* Start timer */
    TIM1->CR1 |= TIM_CR1_CEN;
}

/*
 * SVPWM (7-segment, center-aligned, zero vector Z0) -- iSVPWMz0 math from
 * the verified G474RETEST project.
 *
 *  v_mag_ref : reference voltage magnitude (|V|)
 *  vdc       : DC bus voltage
 *  ph_deg    : reference phase in degrees [0, 360)
 *  ccr_buf   : out, [Ta, Tb, Tc] compare values for TIM1 CCR1..3
 */
static void svpwm(float v_mag_ref, float vdc, float ph_deg, uint32_t ccr_buf[])
{
    float theta, Rtheta, mi, miK, SINx, SINXm;
    float T1, T2, Tw;
    int sect;

    /* Modulation index: mi = 2|V| / Vdc */
    if (vdc == 0.0f) {
        mi = 0.0f;
    } else {
        mi = 2.0f * v_mag_ref / vdc;
    }

    /* miK maps into timer counts using ARR as the peak compare value */
    miK = SQRT3_DIV2 * PWM_PERIOD * mi;

    /* Sector 0..5 (60 degrees each) and angle within the sector */
    sect = (int)(ph_deg / 60.0f);
    if (sect > 5) {
        sect = 5;
    }
    theta = ph_deg - (float)sect * 60.0f;
    Rtheta = theta * DEG2RAD;

    SINXm = sinf(PI_DIV3 - Rtheta);
    SINx  = sinf(Rtheta);

    /* Active vector times (in timer counts) */
    T1 = miK * SINXm;
    T2 = miK * SINx;
    Tw = T1 + T2;

    /* Overmodulation / count clamp so CCR never exceeds ARR */
    if (Tw > (float)PWM_PERIOD) {
        float s = (float)PWM_PERIOD / Tw;
        T1 *= s;
        T2 *= s;
        Tw = (float)PWM_PERIOD;
    }

    switch (sect) {
    case 0: ccr_buf[0] = (uint32_t)Tw; ccr_buf[1] = (uint32_t)T2; ccr_buf[2] = 0; break;
    case 1: ccr_buf[0] = (uint32_t)T1; ccr_buf[1] = (uint32_t)Tw; ccr_buf[2] = 0; break;
    case 2: ccr_buf[0] = 0;            ccr_buf[1] = (uint32_t)Tw; ccr_buf[2] = (uint32_t)T2; break;
    case 3: ccr_buf[0] = 0;            ccr_buf[1] = (uint32_t)T1; ccr_buf[2] = (uint32_t)Tw; break;
    case 4: ccr_buf[0] = (uint32_t)T2; ccr_buf[1] = 0;            ccr_buf[2] = (uint32_t)Tw; break;
    default: ccr_buf[0] = (uint32_t)Tw; ccr_buf[1] = 0;           ccr_buf[2] = (uint32_t)T1; break;
    }
}

static inline void set_three_phase_pwm(uint32_t a, uint32_t b, uint32_t c)
{
    TIM1->CCR1 = a;
    TIM1->CCR2 = b;
    TIM1->CCR3 = c;
}

static void timer_update_isr(void)
{
    TIM1->SR &= ~TIM_SR_UIF;

    static float theta = 0.0f;

    /* Advance the electrical angle each update (43.2 kHz here) */
    theta += 2.0f * PI * fout * T_ISR;
    if (theta >= 2.0f * PI) {
        theta -= 2.0f * PI;
    }

    /* Generate a rotating reference voltage vector (open-loop test). */
    uint32_t ccr_buf[3];
    svpwm(v_mag, vdc, theta * (180.0f / PI), ccr_buf);

    set_three_phase_pwm(ccr_buf[0], ccr_buf[1], ccr_buf[2]);
}

void init_tim1_irq(void)
{
    IRQ_CONNECT(TIM1_UP_TIM16_IRQn, 0, timer_update_isr, NULL, 0);
    irq_enable(TIM1_UP_TIM16_IRQn);
}

void set_frequency(float fre)
{
    fout = fre;
}

void set_magnitude(float mag)
{
    v_mag = mag;
}

/* Stop the SVPWM: halt the timer and force every output to a safe (off)
 * compare value so the bridge is parked rather than free-running. */
void svpwm_stop(void)
{
    TIM1->CR1 &= ~TIM_CR1_CEN;

    /* 0 = full active-low -> gate driver off: safe bridge. */
    set_three_phase_pwm(0, 0, 0);
}

/* (Re)start the SVPWM: re-enable the timer and the rotating vector ISR. */
void svpwm_start(void)
{
    TIM1->CR1 |= TIM_CR1_CEN;
}
```

## src/spi_cmd.c
```c
/*
 * spi_cmd.c -- SPI command link (master side, NUCLEO-G474RE)
 *
 * Receives SVPWM reference commands (electrical frequency + voltage
 * magnitude) from the H7S78-DK SPI4 slave.
 *
 * Transport: SPI1 master (SCK=PA5, MISO=PA6, MOSI=PA7, CS=PB6 GPIO).  The
 * slave drives the SVPWM control by asserting a notification GPIO (PC7) when
 * it has a new command ready, at which point this module clocks an 8-byte
 * frame from the slave and applies it.
 *
 * Frame (both directions, master TX always 8 bytes of 0x00):
 *   [0]  magic   0xAA
 *   [1]  cmd     0x01 = set reference
 *   [2]  freq_hi freq*100 big-endian high byte
 *   [3]  freq_lo freq*100 big-endian low  byte
 *   [4]  mag_hi  mag*100  big-endian high byte
 *   [5]  mag_lo  mag*100  big-endian low  byte
 *   [6]  crc     XOR of bytes [0..5]
 *   [7]  tail    0x55
 */

#include <stdint.h>
#include <string.h>
#include <zephyr/kernel.h>
#include <zephyr/drivers/gpio.h>
#include <zephyr/drivers/spi.h>
#include <zephyr/device.h>
#include <zephyr/logging/log.h>

#include <zephyr/sys/byteorder.h>

#include "control.h"
#include "spi_cmd.h"

LOG_MODULE_REGISTER(spi_cmd, LOG_LEVEL_INF);

#define SPI_DEV_NODE   DT_NODELABEL(spi1)
#define NOTIFY_NODE    DT_NODELABEL(gpioc)
#define NOTIFY_PIN     7u          /* PC7: slave PD12 -> master PC7 */

#define CMD_FRAME_LEN  8u
#define CMD_MAGIC      0xAAu
#define CMD_SET_REF    0x01u
#define CMD_START      0x02u
#define CMD_STOP       0x03u
#define CMD_TAIL       0x55u

#define CMD_STACK_SIZE 1024u
#define CMD_PRIO       1u
#define POLL_MS        50u   /* periodic poll fallback (ms) */

static const struct device *spi_dev;
static const struct device *notify_dev;

static struct gpio_callback notify_cb;
static K_SEM_DEFINE(cmd_sem, 0, 1);

K_THREAD_STACK_DEFINE(cmd_stack, CMD_STACK_SIZE);
static struct k_thread cmd_thread_data;

static uint8_t tx_buf[CMD_FRAME_LEN];
static uint8_t rx_buf[CMD_FRAME_LEN];
static struct spi_buf tx_spi_buf = { .buf = tx_buf, .len = CMD_FRAME_LEN };
static struct spi_buf rx_spi_buf = { .buf = rx_buf, .len = CMD_FRAME_LEN };
static const struct spi_buf_set tx = { .buffers = &tx_spi_buf, .count = 1 };
static const struct spi_buf_set rx = { .buffers = &rx_spi_buf, .count = 1 };

/* Master, 8-bit, MSB-first, mode 0 (CPOL=0, CPHA=0), GPIO chip-select PB6. */
static const struct spi_config spi_cfg = {
    .frequency = 1000000U,
    .operation = SPI_OP_MODE_MASTER | SPI_WORD_SET(8) | SPI_TRANSFER_MSB,
    .slave = 0,
    .cs = {
        .gpio = {
            .port = DEVICE_DT_GET(DT_NODELABEL(gpiob)),
            .pin = 6,
            .dt_flags = GPIO_ACTIVE_LOW,
        },
    },
};

static void notify_cb_isr(const struct device *dev, struct gpio_callback *cb,
              uint32_t pins)
{
    ARG_UNUSED(dev);
    ARG_UNUSED(cb);
    ARG_UNUSED(pins);
    k_sem_give(&cmd_sem);
}

static uint8_t frame_crc(const uint8_t *f)
{
    uint8_t c = 0;
    for (int i = 0; i < 6; i++) {
        c ^= f[i];
    }
    return c;
}

static int handle_frame(const uint8_t *f)
{
    /* Validate envelope/CRC. */
    if (f[0] != CMD_MAGIC || f[7] != CMD_TAIL || f[6] != frame_crc(f)) {
        LOG_WRN("bad frame: magic=%02X tail=%02X crc=%02X/%02X",
            f[0], f[7], f[6], frame_crc(f));
        return -EINVAL;
    }

    /* Big-endian value*100. */
    uint16_t f100 = ((uint16_t)f[2] << 8) | f[3];
    uint16_t m100 = ((uint16_t)f[4] << 8) | f[5];

    float freq = (float)f100 / 100.0f;   /* Hz */
    float mag  = (float)m100  / 100.0f;  /* V */

    /* Sanity limits. */
    if (freq > 4000.0f || mag > 50.0f) {
        LOG_WRN("out-of-range freq=%u mag=%u", f100, m100);
        return -ERANGE;
    }

    /* Always apply the reference so START/STOP frames can carry it too. */
    set_frequency(freq);
    set_magnitude(mag);

    /* Act on the command byte. START/STOP are persistent per-loop frame state
     * from the slave, so they reliably toggle the timer on and off. */
    switch (f[1]) {
    case CMD_SET_REF:
    case CMD_START:
        svpwm_start();
        LOG_INF("ref start: f=%.2f Hz, v=%.2f V", freq, mag);
        break;

    case CMD_STOP:
        svpwm_stop();
        LOG_INF("ref stop: f=%.2f Hz, v=%.2f V", freq, mag);
        break;

    default:
        LOG_WRN("unknown cmd 0x%02X", f[1]);
        return -EINVAL;
    }

    return 0;
}

static void cmd_thread(void *a, void *b, void *c)
{
    ARG_UNUSED(a);
    ARG_UNUSED(b);
    ARG_UNUSED(c);

    /* Poison the TX payload; only RX carries data. */
    memset(tx_buf, 0, sizeof(tx_buf));

    while (1) {
        /* Wake immediately on a notify edge (prompt), but also poll every
         * POLL_MS so the link recovers even if an edge is missed or the
         * slave updates just after we read.  This never deadlocks: the
         * slave's blocking transceive completes on our next clock. */
        k_sem_take(&cmd_sem, K_MSEC(POLL_MS));

        int ret = spi_transceive(spi_dev, &spi_cfg, &tx, &rx);
        if (ret != 0) {
            LOG_ERR("spi_transceive failed: %d", ret);
            continue;
        }

        handle_frame(rx_buf);
    }
}

int spi_cmd_start(void)
{
    spi_dev = DEVICE_DT_GET(SPI_DEV_NODE);
    if (!device_is_ready(spi_dev)) {
        LOG_ERR("spi1 not ready");
        return -ENODEV;
    }

    notify_dev = DEVICE_DT_GET(NOTIFY_NODE);
    if (!device_is_ready(notify_dev)) {
        LOG_ERR("gpioc not ready");
        return -ENODEV;
    }

    /* PC7 input pulled down; interrupt on rising edge (slave assert). */
    int ret = gpio_pin_configure(notify_dev, NOTIFY_PIN,
                     GPIO_INPUT | GPIO_PULL_DOWN);
    if (ret != 0) {
        LOG_ERR("notify pin config failed: %d", ret);
        return ret;
    }

    gpio_init_callback(&notify_cb, notify_cb_isr, BIT(NOTIFY_PIN));
    ret = gpio_add_callback(notify_dev, &notify_cb);
    if (ret != 0) {
        LOG_ERR("gpio callback add failed: %d", ret);
        return ret;
    }

    ret = gpio_pin_interrupt_configure(
        notify_dev, NOTIFY_PIN,
        GPIO_INT_EDGE_RISING | GPIO_INT_ENABLE);
    if (ret != 0) {
        LOG_ERR("notify irq config failed: %d", ret);
        return ret;
    }

    k_thread_create(&cmd_thread_data, cmd_stack, CMD_STACK_SIZE,
            cmd_thread, NULL, NULL, NULL, CMD_PRIO, 0, K_NO_WAIT);

    LOG_INF("spi_cmd start: spi1 master + PC7 notify ready");
    return 0;
}
```
