## CMakeLists.txt
```
cmake_minimum_required(VERSION 3.20.0)

find_package(Zephyr REQUIRED)

project(
  combined_h7s78
  DESCRIPTION "STM32H7S78-DK touchscreen SVPWM controller (LVGL UI + SPI4 slave)"
  VERSION 1
  LANGUAGES C
)

file(GLOB APP_SOURCES src/*.c)

target_sources(app PRIVATE ${APP_SOURCES})
target_sources(app PRIVATE src/slave_ctl.c)

target_include_directories(app PRIVATE include)

add_subdirectory(ui)

target_link_libraries(app PRIVATE ui)

target_include_directories(app PRIVATE include)
```

## Kconfig
```
mainmenu "controller"
  config STM32_HAL_TIM
    default y
    bool
    select USE_STM32_HAL_TIM
    select USE_STM32_HAL_TIM_EX

source "Kconfig.zephyr"
```

## prj.conf
```kconfig
CONFIG_LV_Z_MEM_POOL_SIZE=262144
CONFIG_MAIN_STACK_SIZE=8192

# SPI slave link to the G474RE SVPWM master
CONFIG_SPI=y
# Software slave-select (SSM=1): SPI4 slave always selected; the
# master (G474) owns physical CS. No NSS AF pin needed on PE4.
CONFIG_SPI_STM32_USE_HW_SS=n

# Interrupt-driven transceive gives the slave's blocking spi_transceive a
# finite completion timeout (~MAX(tx,rx)*8*1000/freq + tolerance ≈ 264 ms)
# instead of the polled-mode busy-wait that used to wedge the slave forever
# when the master clocked a frame before the slave was armed. CONFIG_SPI_SLAVE
# must stay OFF here: with it enabled the driver uses K_FOREVER in slave mode
# and the timeout (and thus the self-healing retry) disappears.
CONFIG_SPI_STM32_INTERRUPT=y

# Keep the always-listening idle window short (~64 ms transfer + tolerance) so
# a pressed button reaches the master quickly and a lost frame is retried
# fast, without the old 264 ms latency before STOP takes effect.
CONFIG_SPI_COMPLETION_TIMEOUT_TOLERANCE=50

CONFIG_DISPLAY=y

# display config (DK native LTDC panel, chosen via board dts)
CONFIG_LVGL=y
CONFIG_LV_USE_LABEL=y
# larger font for the footer info readout
CONFIG_LV_FONT_MONTSERRAT_20=y

# input config (DK native GT911 touch, chosen via board dts;
# INPUT_GT911 + interrupt mode default on when INPUT is enabled)
CONFIG_INPUT=y
CONFIG_LV_Z_POINTER_INPUT=y

CONFIG_SHELL=y
CONFIG_PRINTK=y

# picolibc: enable %f in printf/snprintf (gauge/card/slider value text)
CONFIG_PICOLIBC_IO_FLOAT=y

CONFIG_SERIAL=y
```

## app.overlay
```dts
/*
 * combined_h7s78 -- STM32H7S78-DK touchscreen SVPWM controller
 *
 * Merges the LVGL display/touch UI (dk_h7s78) with the SPI4 slave link
 * (h7s78_spi_slave). The touchscreen sets the SVPWM reference (electrical
 * frequency + voltage magnitude); the SPI slave packs it into an 8-byte
 * frame, asserts PD12, and the G474RE SPI1 master clocks it and drives its
 * TIM1 SVPWM controller.
 *
 * Display/touch: the DK's native LTDC RGB panel (800x480) and GT911 I2C touch
 * controller are already enabled by the board dts, so no display nodes are
 * needed here.
 *
 * SPI4 SLAVE on the Pmod CN4 connector:
 *   pin2 MOSI = PE14 (SPI4_MOSI)
 *   pin3 MISO = PE13 (SPI4_MISO)
 *   pin4 SCK  = PE12 (SPI4_SCK)
 *   pin1 CS   = PE4  / software slave-select (SSM=1): slave is always
 *                    selected; no NSS AF needed.
 *
 * NOTE: The dk_h7s78 demo previously muxed TIM1_CH3 onto PE13 for a leftover
 * SVPWM demo on the H7S78. That demo is dropped so PE13 is free for
 * SPI4_MISO; the real SVPWM runs on the G474RE (g474_svpwm project).
 */

&spi4 {
	status = "okay";
	pinctrl-0 = <&spi4_sck_pe12 &spi4_miso_pe13 &spi4_mosi_pe14>;
	pinctrl-names = "default";
};
```

## src/main.c
```c
#include <string.h>
#include <lvgl.h>
#include <zephyr/kernel.h>
#include <zephyr/drivers/spi.h>
#include <zephyr/drivers/display.h>
#include <zephyr/device.h>
#include "display/lv_display.h"
#include "hmi.h"
#include "slave_ctl.h"

#define SPI_DEV_NODE DT_NODELABEL(spi4)

#define SPI_FREQ_HZ 1000000U

#define LVGL_TICK_MS 5u

static const struct device *spi_dev;

static uint8_t rx_buf[SLAVE_CTL_LEN];

static struct spi_buf tx_spi_buf;
static struct spi_buf rx_spi_buf;
static const struct spi_buf_set rx = { &rx_spi_buf, 1 };
static const struct spi_buf_set tx = { &tx_spi_buf, 1 };

/* The blocking SPI slave transceive runs on its own thread so a pending
 * exchange can never stall the LVGL renderer/input on the main thread. */
#define SPI_STACK_SIZE 2048u
#define SPI_PRIO       5u
K_THREAD_STACK_DEFINE(spi_stack, SPI_STACK_SIZE);
static struct k_thread spi_thread_data;

/* Slave, 8-bit word, MSB first, Motorola mode 0. Software slave-select
 * (SSM=1): the peripheral is always selected and each full-duplex burst
 * (clocked by the G474 master) shifts the latest TX frame onto MISO. */
static const struct spi_config spi_cfg = {
    .frequency = SPI_FREQ_HZ,
    .operation = SPI_OP_MODE_SLAVE | SPI_WORD_SET(8) |
                 SPI_TRANSFER_MSB,
    .slave = 0,
    .cs = { .gpio = { .port = NULL, .pin = 0, .dt_flags = 0 } },
};

/* Dedicated SPI slave worker: an always-listening loop that keeps the slave
 * armed inside a blocking transceive nearly 100% of the time. When the UI
 * state changes it packs the new frame and raises PD12 while the slave is
 * actually armed; the G474 master is edge-driven and clocks the frame, and
 * the transceive returns 0 only on a completed exchange. If the master never
 * clocks (frame lost to the arm race), the interrupt-mode transceive times
 * out (~264 ms), PD12 is lowered, and the change stays "dirty" so the next
 * iteration raises a fresh edge and retries -- the link self-heals instead
 * of wedging forever.
 *
 * Reads the frame right before each exchange so it always carries the latest
 * committed state (matches the header's documented "SPI slave loop"). */
static void spi_thread_fn(void *a, void *b, void *c)
{
    ARG_UNUSED(a);
    ARG_UNUSED(b);
    ARG_UNUSED(c);

    bool last_run = false;
    float last_freq = 0.0f;
    float last_mag = 0.0f;

    while (1) {
        bool run = hmi_ctl_get_running();
        float freq = hmi_ctl_get_frequency();
        float mag = hmi_ctl_get_magnitude();

        bool dirty = (run != last_run) || (freq != last_freq) ||
                     (mag != last_mag);

        if (dirty) {
            slave_ctl_pack_state(run ? SLAVE_CTL_CMD_START : SLAVE_CTL_CMD_STOP,
                                 freq, mag);
            slave_ctl_notify(true);
        }

        memset(rx_buf, 0, sizeof(rx_buf));
        rx_spi_buf.buf = rx_buf;
        rx_spi_buf.len = sizeof(rx_buf);
        tx_spi_buf.buf = slave_ctl_frame();
        tx_spi_buf.len = SLAVE_CTL_LEN;

        int ret = spi_transceive(spi_dev, &spi_cfg, &tx, &rx);

        slave_ctl_notify(false);

        if (ret == 0) {
            last_run = run;
            last_freq = freq;
            last_mag = mag;
        } else if (ret != -ETIMEDOUT) {
            printk("slave spi_transceive error: %d\n", ret);
        }
    }
}

int main(void)
{
    const struct device *display_dev = DEVICE_DT_GET(DT_CHOSEN(zephyr_display));

    spi_dev = DEVICE_DT_GET(SPI_DEV_NODE);
    if (!device_is_ready(spi_dev)) {
        printk("SPI4 slave not ready\n");
        return -1;
    }

    if (slave_ctl_init() != 0) {
        printk("slave_ctl init failed\n");
        return -1;
    }

    hmi_create_control(lv_screen_active());
    display_blanking_off(display_dev);

    k_thread_create(&spi_thread_data, spi_stack, SPI_STACK_SIZE,
                    spi_thread_fn, NULL, NULL, NULL, SPI_PRIO, 0, K_NO_WAIT);

    printk("SVPWM touchscreen controller ready (SPI4 slave + LVGL UI)\n");

    while (1) {
        lv_timer_handler();
        k_sleep(K_MSEC(LVGL_TICK_MS));
    }
    return 0;
}
```

## include/slave_ctl.h
```c
#pragma once

/**
 * slave_ctl.h -- SVPWM controller command API (slave side, STM32H7S78-DK)
 *
 * The H7S78-DK acts as an LVGL touchscreen controller AND an SPI slave. The
 * touchscreen drives the G474RE SVPWM controller's electrical frequency and
 * voltage magnitude. Commands are packed into an 8-byte SPI frame in the
 * slave TX buffer; the SPI worker raises the notification GPIO (PD12) only
 * while the slave is armed inside a blocking transceive, so the master
 * (G474RE) clocks the frame over its SPI1 link only when the slave is ready.
 *
 * Frame (matches spi_cmd.c on the master):
 *   [0] magic 0xAA
 *   [1] cmd   0x01 = set reference | 0x02 = start | 0x03 = stop
 *   [2..3] frequency *100 big-endian
 *   [4..5] magnitude *100 big-endian
 *   [6] crc   XOR of [0..5]
 *   [7] tail  0x55
 *
 * Thread-safety: packing only writes the static TX frame and is called from
 * the SPI worker thread; the LVGL UI thread never touches this API.
 */

#include <stdbool.h>
#include <stdint.h>

#define SLAVE_CTL_MAGIC   0xAAu
#define SLAVE_CTL_CMD_REF 0x01u
#define SLAVE_CTL_CMD_START 0x02u
#define SLAVE_CTL_CMD_STOP  0x03u
#define SLAVE_CTL_TAIL    0x55u
#define SLAVE_CTL_LEN     8u

/* Returns pointer to the current 8-byte TX frame (master's read space). */
uint8_t *slave_ctl_frame(void);

/* Init: build the static frame envelope and configure PD12 notify output. */
int slave_ctl_init(void);

/* Pack START/STOP/REF plus frequency (Hz) and magnitude (V) into the TX
 * frame. Pure data operation: does NOT touch the notify line; the caller
 * drives it with slave_ctl_notify(). */
void slave_ctl_pack_state(uint8_t cmd, float freq_hz, float mag_v);

/* Drive the notification line (PD12) to the given level. The SPI worker
 * raises it before each armed transceive and lowers it afterwards, so a new
 * rising edge is available for every (re)transmission attempt. */
void slave_ctl_notify(bool level);
```

## include/ui.h
```c
#pragma once

void init_ui(void);
```

## src/slave_ctl.c
```c
/*
 * slave_ctl.c -- SVPWM controller command API (slave side, STM32H7S78-DK)
 *
 * Packs electrical-frequency / voltage-magnitude / start-stop commands into
 * the SPI TX frame. The notification GPIO (PD12) is driven as a level by
 * slave_ctl_notify(); the SPI worker raises it only while the slave is
 * actually armed inside a blocking transceive, so the G474RE master clocks
 * the frame over its SPI1 link only when the slave is ready. On a missed
 * exchange the worker simply raises a fresh edge and retries.
 *
 * The frame lives in a static buffer here; the SPI transceive in main.c must
 * point its TX buffer at slave_ctl_frame().
 */

#include <stdbool.h>
#include <string.h>
#include <zephyr/drivers/gpio.h>
#include <zephyr/device.h>

#include "slave_ctl.h"

#define NOTIFY_NODE   DT_NODELABEL(gpiod)
#define NOTIFY_PIN    12u   /* PD12: slave -> master PC7 */

static uint8_t ctl_frame[SLAVE_CTL_LEN];

static const struct gpio_dt_spec notify = {
    .port = DEVICE_DT_GET(NOTIFY_NODE),
    .pin = NOTIFY_PIN,
    .dt_flags = GPIO_OUTPUT | GPIO_ACTIVE_HIGH,
};

static uint8_t frame_crc(const uint8_t *f)
{
    uint8_t c = 0;
    for (int i = 0; i < 6; i++) {
        c ^= f[i];
    }
    return c;
}

/* Pack a full command into the frame (does not touch the notify line). */
void slave_ctl_pack_state(uint8_t cmd, float freq_hz, float mag_v)
{
    ctl_frame[0] = SLAVE_CTL_MAGIC;

    if (cmd == SLAVE_CTL_CMD_START) {
        ctl_frame[1] = SLAVE_CTL_CMD_START;
    } else if (cmd == SLAVE_CTL_CMD_STOP) {
        ctl_frame[1] = SLAVE_CTL_CMD_STOP;
    } else {
        ctl_frame[1] = SLAVE_CTL_CMD_REF;
    }

    uint16_t f100 = (uint16_t)(freq_hz * 100.0f);
    ctl_frame[2] = (uint8_t)(f100 >> 8);
    ctl_frame[3] = (uint8_t)(f100 & 0xFF);

    uint16_t m100 = (uint16_t)(mag_v * 100.0f);
    ctl_frame[4] = (uint8_t)(m100 >> 8);
    ctl_frame[5] = (uint8_t)(m100 & 0xFF);

    ctl_frame[6] = frame_crc(ctl_frame);
    ctl_frame[7] = SLAVE_CTL_TAIL;
}

void slave_ctl_notify(bool level)
{
    gpio_pin_set_dt(&notify, level ? 1 : 0);
}

uint8_t *slave_ctl_frame(void)
{
    return ctl_frame;
}

int slave_ctl_init(void)
{
    ctl_frame[0] = SLAVE_CTL_MAGIC;
    ctl_frame[1] = SLAVE_CTL_CMD_REF;
    ctl_frame[2] = 0;
    ctl_frame[3] = 0;
    ctl_frame[4] = 0;
    ctl_frame[5] = 0;
    ctl_frame[6] = frame_crc(ctl_frame);
    ctl_frame[7] = SLAVE_CTL_TAIL;

    if (!device_is_ready(notify.port)) {
        return -ENODEV;
    }
    if (gpio_pin_configure_dt(&notify, GPIO_OUTPUT | GPIO_ACTIVE_HIGH) != 0) {
        return -EIO;
    }
    gpio_pin_set_dt(&notify, 0);

    return 0;
}
```
